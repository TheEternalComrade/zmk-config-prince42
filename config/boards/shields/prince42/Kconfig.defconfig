## config/boards/shields/prince42/Kconfig.defconfig
```kconfig
if SHIELD_PRINCE42_LEFT

config ZMK_KEYBOARD_NAME
    default "Prince42"

config ZMK_SPLIT_ROLE_CENTRAL
    default y

endif

if SHIELD_PRINCE42_LEFT || SHIELD_PRINCE42_RIGHT

config ZMK_SPLIT
    default y

endif
```

## config/boards/shields/prince42/Kconfig.shield
```kconfig
config SHIELD_PRINCE42_LEFT
    def_bool $(shields_list_contains,prince42_left)

config SHIELD_PRINCE42_RIGHT
    def_bool $(shields_list_contains,prince42_right)
```
